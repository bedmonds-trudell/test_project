## bt_test/build/Kconfig/arch/Kconfig
```kconfig
# Load Zephyr Arch Kconfig descriptions.
osource "C:/Users/brandon.edmonds/dev/repos/test/deps/zephyr/arch/x86/Kconfig"
osource "C:/Users/brandon.edmonds/dev/repos/test/deps/zephyr/arch/xtensa/Kconfig"
osource "C:/Users/brandon.edmonds/dev/repos/test/deps/zephyr/arch/sparc/Kconfig"
osource "C:/Users/brandon.edmonds/dev/repos/test/deps/zephyr/arch/riscv/Kconfig"
osource "C:/Users/brandon.edmonds/dev/repos/test/deps/zephyr/arch/posix/Kconfig"
osource "C:/Users/brandon.edmonds/dev/repos/test/deps/zephyr/arch/nios2/Kconfig"
osource "C:/Users/brandon.edmonds/dev/repos/test/deps/zephyr/arch/mips/Kconfig"
osource "C:/Users/brandon.edmonds/dev/repos/test/deps/zephyr/arch/arm64/Kconfig"
osource "C:/Users/brandon.edmonds/dev/repos/test/deps/zephyr/arch/arm/Kconfig"
osource "C:/Users/brandon.edmonds/dev/repos/test/deps/zephyr/arch/arc/Kconfig"
```

## button/build/Kconfig/boards/Kconfig
```kconfig
# Load Zephyr board Kconfig descriptions.
osource "C:/Users/brandon.edmonds/dev/repos/test/deps/zephyr/boards/nordic/nrf52840dk/Kconfig"
```

## button/build/Kconfig/boards/Kconfig.sysbuild
```kconfig
# Load Sysbuild board Kconfig descriptions.
osource "C:/Users/brandon.edmonds/dev/repos/test/deps/zephyr/boards/nordic/nrf52840dk/Kconfig.sysbuild"
```

## test/sapp/build/Kconfig/boards/Kconfig.defconfig
```kconfig
# Load Zephyr board defconfig descriptions.
osource "C:/Users/brandon.edmonds/dev/repos/test/deps/zephyr/boards/nordic/nrf52840dk/Kconfig.defconfig"
```

## west.yml
```yaml
manifest:
  version: 0.8

  self:
    path: dev

  projects:
    - name: zephyr
      url: https://github.com/zephyrproject-rtos/zephyr
      revision: v4.0.0
      import:
        file: west.yml
        path-prefix: deps
        name-allowlist:
          - nrf
          - zephyr
          - hal_nordic
          - tinycrypt
          - segger
          - cmsis
```
