## CMakeLists.txt
```
cmake_minimum_required(VERSION 3.20.0)
find_package(Zephyr REQUIRED HINTS $ENV{ZEPHYR_BASE})

project(bt_test)

target_sources(app PRIVATE src/main.c)
```

## prj.conf
```kconfig
CONFIG_LOG=y

CONFIG_BT=y
CONFIG_BT_PERIPHERAL=y
CONFIG_BT_DEVICE_NAME="Nordic_Peripheral"
CONFIG_BT_PRIVACY=y

CONFIG_NVS=y
CONFIG_FLASH=y
CONFIG_FLASH_MAP=y

CONFIG_SETTINGS=y
CONFIG_SETTINGS_NVS=y
CONFIG_SETTINGS_RUNTIME=y
CONFIG_SETTINGS_NONE=y

CONFIG_BT_SETTINGS=y
CONFIG_BT_ID_MAX=2

CONFIG_BT_GATT_CACHING=n

CONFIG_MPU_ALLOW_FLASH_WRITE=y
```

## src/main.c
```c
#include <zephyr/kernel.h>
#include <zephyr/bluetooth/bluetooth.h>
#include <zephyr/bluetooth/addr.h>
#include <zephyr/settings/settings.h>

size_t num_ids = 0;

void print_ids(void)
{
  char addr_str[BT_ADDR_LE_STR_LEN];

  bt_id_get(NULL, &num_ids);
  printk("Num IDs: %d\n", num_ids);
  bt_addr_le_t addrs[num_ids];
  
  for (int i = 0; i < num_ids; i++) {
    bt_id_get(addrs, &num_ids);
    bt_addr_le_to_str(&addrs[i], addr_str, sizeof(addr_str));
    printk("Addr[%d]: %s\n", i, addr_str);
  }
}

int main(void)
{
  print_ids();

  bt_addr_le_t new_addr;

	int err = bt_enable(NULL);
	if (err) printk("Bluetooth init failed (err %d)\n", err);

  err = settings_load();
  if (err) printk("settings_load failed (err %d)\n", err);

  print_ids();

  if (num_ids < CONFIG_BT_ID_MAX) {
    bt_addr_le_t new_addr;

    err = bt_addr_le_from_str("FF:EE:DD:CC:BB:AA", "random", &new_addr);
    if (err) printk("Invalid BT address (err %d)\n", err);

    err = bt_id_create(&new_addr, NULL);
    if (err) printk("Creating new ID failed (err %d)\n", err);

    print_ids();
  }
	
  return 0;
}
```
